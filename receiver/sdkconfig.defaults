## receiver/sdkconfig.defaults
```kconfig
# Receiver-specific configuration
# Inherits from ../sdkconfig.defaults.common

# FreeRTOS Timer Configuration (needed for timeout logging)
CONFIG_FREERTOS_TIMER_TASK_STACK_DEPTH=4096

# Stack Overflow Detection (always enabled for safety)
CONFIG_FREERTOS_CHECK_STACKOVERFLOW_PTRVAL=y

# Stack Debug Monitoring (disable for production)
# CONFIG_STACK_DEBUG=y
```

## sdkconfig.defaults.common
```kconfig
# Shared ESP-NOW Lap Timer Configuration
# Used by both transmitter and receiver

# ESP-NOW Configuration
CONFIG_ESP_WIFI_ENABLED=y
CONFIG_ESP_WIFI_STATIC_RX_BUFFER_NUM=10
CONFIG_ESP_WIFI_DYNAMIC_RX_BUFFER_NUM=32

# Logging Configuration
CONFIG_LOG_DEFAULT_LEVEL_INFO=y

# NVS Configuration
CONFIG_NVS_ENCRYPTION=n
```

## transmitter/sdkconfig.defaults
```kconfig
# Transmitter-specific configuration
# Inherits from ../sdkconfig.defaults.common

# Add transmitter-specific configs here if needed
CONFIG_ESP_PHY_MAX_TX_POWER=10
```
